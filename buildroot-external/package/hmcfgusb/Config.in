## buildroot-external/package/hmcfgusb/Config.in
```kconfig
config BR2_PACKAGE_HMCFGUSB
	bool "hmcfgusb (flash-hmcfgusb)"
	depends on BR2_TOOLCHAIN_HAS_THREADS # libusb
	select BR2_PACKAGE_LIBUSB
	help
	  flash-hmcfgusb from Michael Gernoth's hmcfgusb: updates the
	  firmware of an eQ-3 HM-CFG-USB-2 BidCos-RF adapter (neither
	  rfd nor eq3configcmd can). openccu-lite's Interfaces page
	  runs it with a firmware file the user uploads.

	  https://git.zerfleddert.de/cgi-bin/gitweb.cgi/hmcfgusb
```

## buildroot-external/package/lite-bindlo/Config.in
```kconfig
config BR2_PACKAGE_LITE_BINDLO
	bool "lite-bindlo"
	depends on BR2_TOOLCHAIN_HAS_THREADS # dlsym
	help
	  openccu-lite: an LD_PRELOAD shim that binds a listed port's
	  wildcard bind() to the loopback. hmipserver's unit uses it for
	  its HTTP port 39292, for which hmipserver has no bind-address
	  setting.
```

## buildroot-external/package/occulited/Config.in
```kconfig
config BR2_PACKAGE_OCCULITED
	bool "occulited - the openccu-lite system service"
	depends on BR2_PACKAGE_HOST_GO_TARGET_ARCH_SUPPORTS
	depends on BR2_PACKAGE_OPENCCU_BASE
	select BR2_PACKAGE_LIGHTTPD
	select BR2_PACKAGE_LIGHTTPD_LUA
	select BR2_PACKAGE_TCL
	help
	  The system service of openccu-lite: the metadata store
	  (device names, rooms, functions) with its API and change
	  stream, the system administration API and web UI, users
	  and sessions. It replaces the CCU WebUI and ReGaHss above
	  the XML-RPC line; the interface processes are untouched.

	  Installs the service, its lighttpd wiring (the /api and
	  shell proxy, the mod_magnet session gate for /addons/),
	  the busybox init script and the tclrega.so shim that
	  answers the session check of addon settings pages. Built
	  from a source archive of the occulited repository at a
	  pinned commit; the web UI is part of that archive, and so
	  is the addon catalogue the system carries (catalog/ of
	  that repository: the catalogue file and the adapter
	  manifests, installed under /etc/occulite).

	  https://github.com/hobbyquaker/occulited
```

## buildroot-external/package/rpi-eeprom/Config.in
```kconfig
config BR2_PACKAGE_RPI_EEPROM
	bool "rpi-eeprom"
	help
	  EEPROM bootloader firmware for Raspberry Pi 4 and Pi 5

	  https://github.com/raspberrypi/rpi-eeprom

if BR2_PACKAGE_RPI_EEPROM

choice
	prompt "For Target"
	default BR2_PACKAGE_RPI_EEPROM_RPI4

config BR2_PACKAGE_RPI_EEPROM_RPI4
	bool "Raspberry Pi 4"
	help
	  For the Raspberry Pi 4

config BR2_PACKAGE_RPI_EEPROM_RPI5
	bool "Raspberry Pi 5"
	help
	  For the Raspberry Pi 5

endchoice

config BR2_PACKAGE_RPI_EEPROM_OFFER
	bool "Offer the update instead of flashing it at the first boot"
	help
	  openccu-lite (task 366): the update (pieeprom.upd, its .sig,
	  recovery.bin and the VL805 files) is not put into the boot
	  partition, where the boot ROM would flash it at the next
	  start; it is installed under
	  /usr/share/rpi-eeprom/firmware-<chip>/, and occulited's
	  Hardware page offers it. The post-image script leaves the
	  rpi-eeprom files out of boot.vfat.

endif
```
